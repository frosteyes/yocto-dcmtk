## meta-dcmtk/conf/layer.conf
```bitbake
# We have a conf and classes directory, add to BBPATH
BBPATH .= ":${LAYERDIR}"

# We have recipes-* directories, add to BBFILES
BBFILES += "${LAYERDIR}/recipes-*/*/*.bb \
            ${LAYERDIR}/recipes-*/*/*.bbappend"

BBFILE_COLLECTIONS += "meta-dcmtk"
BBFILE_PATTERN_meta-dcmtk = "^${LAYERDIR}/"
BBFILE_PRIORITY_meta-dcmtk = "6"

LAYERDEPENDS_meta-dcmtk = "core"
LAYERSERIES_COMPAT_meta-dcmtk = "dunfell"
```
